## boards/shields/tps43/Kconfig.defconfig
```kconfig
if SHIELD_TPS43

config ZMK_POINTING
    default y

config INPUT
    default y

config INPUT_THREAD
    default y

config ZMK_MOUSE
    default y

endif
```

## config/west.yml
```yaml
manifest:
  remotes:
    - name: zmkfirmware
      url-base: https://github.com/zmkfirmware
    - name: finestedm
      url-base: https://github.com/finestedm
  projects:
    - name: zmk
      remote: zmkfirmware
      revision: main
      import: app/west.yml
    - name: Temper_zmk
      remote: finestedm
      revision: main
  self:
    path: config
```
